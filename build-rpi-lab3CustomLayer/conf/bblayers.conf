## build-rpi-lab3CustomLayer/conf/bblayers.conf
```bitbake
# POKY_BBLAYERS_CONF_VERSION is increased each time build/conf/bblayers.conf
# changes incompatibly
POKY_BBLAYERS_CONF_VERSION = "2"

BBPATH = "${TOPDIR}"
BBFILES ?= ""

BBLAYERS ?= " \
  /home/andrew/yocto/poky/meta \
  /home/andrew/yocto/poky/meta-poky \
  /home/andrew/yocto/poky/meta-yocto-bsp \
  /home/andrew/yocto/meta-raspberrypi \
  /home/andrew/yocto/meta-openembedded/meta-oe \
  /home/andrew/yocto/meta-openembedded/meta-python \
  /home/andrew/yocto/meta-openembedded/meta-networking \
  /home/andrew/yocto/meta-openembedded/meta-multimedia \
  /home/andrew/yocto/meta-ke \
  "
```

## meta-ke/conf/layer.conf
```bitbake
# We have a conf and classes directory, add to BBPATH
BBPATH .= ":${LAYERDIR}"

# We have recipes-* directories, add to BBFILES
BBFILES += "${LAYERDIR}/recipes-*/*/*.bb \
            ${LAYERDIR}/recipes-*/*/*.bbappend"

BBFILE_COLLECTIONS += "meta-ke"
BBFILE_PATTERN_meta-ke = "^${LAYERDIR}/"
BBFILE_PRIORITY_meta-ke = "6"

LAYERDEPENDS_meta-ke = "core"
LAYERSERIES_COMPAT_meta-ke = "dunfell"
```
